## config/Kconfig
```kconfig
mainmenu "NGiNX Configuration"

config ENABLE_LUAJIT
	def_bool n

config ENABLE_ZLIB_NG
	def_bool n

config ENABLE_ZLIB
	def_bool n
	select ENABLE_ZLIB_NG

menu "Global settings"
	config NGX_PREFIX
		string "Installation prefix"
		default "/opt/nginx"

	config ENABLE_SSL
		bool "Enable SSL"
		default y

	config NGX_WITH_SELECT
		bool "Enable select()"
		default n
		---help---
		  Should only be enabled when system does not support
		  kqueue, epoll, or /dev/poll.

	config NGX_WITH_POLL
		bool "Enable poll()"
		default n
		---help---
		  Should only be enabled when system does not support
		  kqueue, epoll, or /dev/poll.

	config ENABLE_DEBUG
		bool "Enable debug"
		default n

	config NGX_WITH_THREADS
		bool "Enable tread pool support"
		default n
		---help---
		  https://www.nginx.com/blog/thread-pools-boost-performance-9x/

	config NGX_WITH_FILE_AIO
		bool "Enable file AIO support"
		default n
		---help---
		  The POSIX asynchronous I/O (AIO) interface allows applications to
		  initiate one or more I/O operations that are performed asynchronously
		  (i.e., in the background).  The application can elect to be notified
		  of completion of the I/O operation in a variety of ways: by delivery
		  of a signal, by instantiation of a thread, or no notification at all.

		  see also thread pool support

	config ENABLE_TCP_FASTOPEN
		bool "Enable TCP fastopen (TFO)"
		default y
		---help---
		  TCP Fast Open (TFO) is an extension to speed up the opening of
		  successive Transmission Control Protocol (TCP) connections between two
		  endpoints. It works by using a TFO cookie (a TCP option), which is a
		  cryptographic cookie stored on the client and set upon the initial
		  connection with the server.  When the client later reconnects, it
		  sends the initial SYN packet along with the TFO cookie data to
		  authenticate itself. If successful, the server may start sending data
		  to the client even before the reception of the final ACK packet of the
		  three-way handshake, skipping that way a round-trip delay and lowering
		  the latency in the start of data transmission.

		  see fastopen=number listen option

	config ENABLE_IPV6
		bool "Enable IPv6"
		default y

	menuconfig NGX_WITH_PCRE
		bool "Enable PCRE"
		default y
	
	if NGX_WITH_PCRE
		config NGX_WITH_PCRE_JIT
			bool "Enable PCRE JIT compilation"
			default y
			depends on NGX_WITH_PCRE
	endif #NGX_WITH_PCRE
endmenu

menuconfig NGX_WITH_HTTP
	bool "HTTP"
	default y

if NGX_WITH_HTTP
	config NGX_WITH_HTTP_SSL_MODULE
		bool "SSL/TLS support"
		default n

	config NGX_WITH_HTTP_V2_MODULE
		bool "v2 support"
		default n

	menuconfig NGX_WITH_HTTP_CACHE
		bool "cache support"
		default y

	if NGX_WITH_HTTP_CACHE
		config NGX_WITH_HTTP_SLICE_MODULE
			bool "slice module"
			default n
			---help---
			  The ngx_http_slice_module module is a filter that splits a request
			  into subrequests, each returning a certain range of response. The
			  filter provides more effective caching of big responses. 

	endif #NGX_WITH_HTTP_CACHE

	config NGX_WITH_HTTP_REALIP_MODULE
		bool "realip module"
		default n
		---help---
		  The ngx_http_realip_module module is used to change the client address
		  and optional port to the one sent in the specified header fields.

	config NGX_WITH_HTTP_ADDITION_MODULE
		bool "addition module"
		default n
		---help---
		  The ngx_http_addition_module module is a filter that adds text before
		  and after a response.

	config NGX_WITH_HTTP_XSLT_MODULE
		bool "xslt module"
		default n
		---help---
		  The ngx_http_xslt_module is a filter that transforms XML responses
		  using one or more XSLT stylesheets.

	config NGX_WITH_HTTP_IMAGE_FILTER_MODULE
		bool "image filter module"
		default n
		---help---
		  The ngx_http_image_filter_module module is a filter that transforms
		  images in JPEG, GIF, and PNG formats.

	config NGX_WITH_HTTP_GEOIP_MODULE
		bool "geoip module"
		default n
		---help---
		   The ngx_http_geoip_module module creates variables with values
		   depending on the client IP address, using the precompiled MaxMind
		   databases.

		   When using the databases with IPv6 support (1.3.12, 1.2.7), IPv4
		   addresses are looked up as IPv4-mapped IPv6 addresses.

	config NGX_WITH_HTTP_SUB_MODULE
		bool "sub module"
		default n
		---help---
		  The ngx_http_sub_module module is a filter that modifies a response by
		  replacing one specified string by another.

	config NGX_WITH_HTTP_DAV_MODULE
		bool "webdav module"
		default n
		---help---
		  The ngx_http_dav_module module is intended for file management
		  automation via the WebDAV protocol. The module processes HTTP and
		  WebDAV methods PUT, DELETE, MKCOL, COPY, and MOVE.

	menu "Video modules"
		config NGX_WITH_HTTP_FLV_MODULE
			bool "flv module"
			default n
			---help---
			  The ngx_http_flv_module module provides pseudo-streaming
			  server-side support for Flash Video (FLV) files.

			  It handles requests with the start argument in the request URI’s
			  query string specially, by sending back the contents of a file
			  starting from the requested byte offset and with the prepended FLV
			  header.

		config NGX_WITH_HTTP_MP4_MODULE
			bool "mp4 module"
			default n
			---help---
			  The ngx_http_mp4_module module provides pseudo-streaming
			  server-side support for MP4 files. Such files typically have the
			  .mp4, .m4v, or .m4a filename extensions.

			  Pseudo-streaming works in alliance with a compatible Flash player.
			  The player sends an HTTP request to the server with the start time
			  specified in the query string argument (named simply start and
			  specified in seconds), and the server responds with the stream
			  such that its start position corresponds to the requested time,
			  for example:

			     http://example.com/elephants_dream.mp4?start=238.88

			  This allows performing a random seeking at any time, or starting
			  playback in the middle of the timeline.
	endmenu #Video modules

	config NGX_WITH_HTTP_AUTH_REQUEST_MODULE
		bool "auth request module"
		default n
		---help---
		  The ngx_http_auth_request_module module implements client
		  authorization based on the result of a subrequest. If the subrequest
		  returns a 2xx response code, the access is allowed. If it returns 401
		  or 403, the access is denied with the corresponding error code. Any
		  other response code returned by the subrequest is considered an error.

		  For the 401 error, the client also receives the "WWW-Authenticate"
		  header from the subrequest response.

	menu "Compression modules"
		config NGX_WITH_HTTP_GZIP_MODULE
			bool "gzip module"
			select ENABLE_ZLIB
			default y
			---help---
			  The ngx_http_gzip_module module is a filter that compresses
			  responses using the "gzip" method. This often helps to reduce the
			  size of transmitted data by half or even more.

		config NGX_WITH_HTTP_GUNZIP_MODULE
			bool "gunzip module"
			select ENABLE_ZLIB
			default n
			---help---
			  The ngx_http_gunzip_module module is a filter that decompresses
			  responses with "Content-Encoding: gzip" for clients that do not
			  support "gzip" encoding method. The module will be useful when it
			  is desirable to store data compressed to save space and reduce I/O
			  costs.

		config NGX_WITH_HTTP_GZIP_STATIC_MODULE
			bool "gzip static module"
			select ENABLE_ZLIB
			default n
			---help---
			  The ngx_http_gzip_static_module module allows sending
			  precompressed files with the ".gz" filename extension instead of
			  regular files.  endif #_NGX_WITH_COMPRESSION
	endmenu #Compression modules

	config NGX_WITH_HTTP_RANDOM_INDEX_MODULE
		bool "random index module"
		default n
		---help---
		  The ngx_http_random_index_module module processes requests ending with
		  the slash character (‘/’) and picks a random file in a directory to
		  serve as an index file. The module is processed before the
		  ngx_http_index_module module.

	config NGX_WITH_HTTP_SECURE_LINK_MODULE
		bool "secure link module"
		default n
		---help---
		  The ngx_http_secure_link_module module is used to check authenticity
		  of requested links, protect resources from unauthorized access, and
		  limit link lifetime.

		  The authenticity of a requested link is verified by comparing the
		  checksum value passed in a request with the value computed for the
		  request. If a link has a limited lifetime and the time has expired,
		  the link is considered outdated. The status of these checks is made
		  available in the $secure_link variable.

		  The module provides two alternative operation modes. The first mode is
		  enabled by the secure_link_secret directive and is used to check
		  authenticity of requested links as well as protect resources from
		  unauthorized access. The second mode is enabled by the secure_link and
		  secure_link_md5 directives and is also used to limit lifetime of
		  links.

	config NGX_WITH_HTTP_DEGRADATION_MODULE
		bool "degradation module"
		default n
		---help---
		  ngx_http_degradation_module orders Nginx to serve a particular error
		  page when low memory conditions are met.

	config NGX_WITH_HTTP_STUB_STATUS_MODULE
		bool "stub status module"
		default n
		---help---
		  The ngx_http_stub_status_module module provides access to basic status
		  information.

	config NGX_WITH_HTTP_CHARSET_MODULE
		bool "charset module"
		default y
		---help---
		   The ngx_http_charset_module module adds the specified charset to the
		   "Content-Type" response header field. In addition, the module can
		   convert data from one charset to another, with some limitations:

		    * conversion is performed one way - from server to client,
		    * only single-byte charsets can be converted
		    * or single-byte charsets to/from UTF-8.

	config NGX_WITH_HTTP_SSI_MODULE
		bool "ssi module"
		default n
		---help---
		  The ngx_http_ssi_module module is a filter that processes SSI (Server
		  Side Includes) commands in responses passing through it. Currently,
		  the list of supported SSI commands is incomplete.

	config NGX_WITH_HTTP_USERID_MODULE
		bool "userid module"
		default y
		---help---
		  The ngx_http_userid_module module sets cookies suitable for client
		  identification. Received and set cookies can be logged using the
		  embedded variables $uid_got and $uid_set. This module is compatible
		  with the mod_uid module for Apache.

	config NGX_WITH_HTTP_ACCESS_MODULE
		bool "access module"
		default y
		---help---
		   The ngx_http_access_module module allows limiting access to certain
		   client addresses.

		   Access can also be limited by password, by the result of subrequest,
		   or by JWT. Simultaneous limitation of access by address and by
		   password is controlled by the satisfy directive.

	config NGX_WITH_HTTP_AUTH_BASIC_MODULE
		bool "auth basic module"
		default y
		---help---
		   The ngx_http_auth_basic_module module allows limiting access to
		   resources by validating the user name and password using the "HTTP
		   Basic Authentication" protocol.

		   Access can also be limited by address, by the result of subrequest,
		   or by JWT. Simultaneous limitation of access by address and by
		   password is controlled by the satisfy directive.

	config NGX_WITH_HTTP_AUTOINDEX_MODULE
		bool "autoindex module"
		default y
		---help---
		  The ngx_http_autoindex_module module processes requests ending with
		  the slash character (‘/’) and produces a directory listing. Usually a
		  request is passed to the ngx_http_autoindex_module module when the
		  ngx_http_index_module module cannot find an index file.

	config NGX_WITH_HTTP_GEO_MODULE
		bool "geo module"
		default y
		---help---
		  The ngx_http_geo_module module creates variables with values
		  depending on the client IP address.

		  Example Configuration:

		    geo $geo {
		      default        0;

		      127.0.0.1      2;
		      192.168.1.0/24 1;
		      10.1.0.0/16    1;

		      ::1            2;
		      2001:0db8::/32 1;
		    }

	config NGX_WITH_HTTP_MAP_MODULE
		bool "map module"
		default y
		---help---
		  The ngx_http_map_module module creates variables whose values depend
		  on values of other variables.

		  Example Configuration:

		    map $http_host $name {
		        hostnames;

		        default       0;

		        example.com   1;
		        *.example.com 1;
		        example.org   2;
		        *.example.org 2;
		        .example.net  3;
		        wap.*         4;
		    }

		    map $http_user_agent $mobile {
		        default       0;
		        "~Opera Mini" 1;
		    }


	config NGX_WITH_HTTP_SPLIT_CLIENTS_MODULE
		bool "split clients module"
		default y
		---help---
		  The ngx_http_split_clients_module module creates variables suitable
		  for A/B testing, also known as split testing. 

		  Example configuration:

		    http {
		      split_clients "${remote_addr}AAA" $variant {
		                     0.5%               .one;
		                     2.0%               .two;
		                     *                  "";
		      }

		      server {
		        location / {
		            index index${variant}.html;
		        }
		      }
		    }


	config NGX_WITH_HTTP_REFERER_MODULE
		bool "referer module"
		default y
		---help---
		  The ngx_http_referer_module module is used to block access to a site
		  for requests with invalid values in the "Referer" header field. It
		  should be kept in mind that fabricating a request with an
		  appropriate "Referer" field value is quite easy, and so the intended
		  purpose of this module is not to block such requests thoroughly but
		  to block the mass flow of requests sent by regular browsers. It
		  should also be taken into consideration that regular browsers may
		  not send the "Referer" field even for valid requests. 

		  Example configuration:

		    valid_referers none blocked server_names
		                   *.example.com example.* www.example.org/galleries/
		                   ~\.google\.;

		    if ($invalid_referer) {
		        return 403;
		    }

	config NGX_WITH_HTTP_REWRITE_MODULE
		bool "rewrite module"
		default y
		---help---
		  The ngx_http_rewrite_module module is used to change request URI
		  using PCRE regular expressions, return redirects, and conditionally
		  select configurations.

		  The ngx_http_rewrite_module module directives are processed in the
		  following order:

		  the directives of this module specified on the server level are
		  executed sequentially; repeatedly:

		    * a location is searched based on a request URI;
		    * the directives of this module specified inside the found location
		      are executed sequentially;
		    * the loop is repeated if a request URI was rewritten, but not more
		      than 10 times.

	menu "*CGI modules"
		config NGX_WITH_HTTP_FASTCGI_MODULE
			bool "fastcgi module"
			default n
			---help---
			  Allows passing requests to a FastCGI server

		config NGX_WITH_HTTP_UWSGI_MODULE
			bool "uwsgi module"
			default y
			---help---
			  Allows passing requests to a uwsgi server

		config NGX_WITH_HTTP_SCGI_MODULE
			bool "scgi module"
			default n
			---help---
			  Allows passing requests to an SCGI server
	endmenu #*CGI modules

	config NGX_WITH_HTTP_MEMCACHED_MODULE
		bool "memcached module"
		default y
		---help---
		  The ngx_http_memcached_module module is used to obtain responses from
		  a memcached server. The key is set in the $memcached_key variable. A
		  response should be put in memcached in advance by means external to
		  nginx.

		  Example configuration:

		    server {
		        location / {
		            set            $memcached_key "$uri?$args";
		            memcached_pass host:11211;
		            error_page     404 502 504 = @fallback;
		        }

		        location @fallback {
		            proxy_pass     http://backend;
		        }
		    }


	config NGX_WITH_HTTP_LIMIT_CONN_MODULE
		bool "limit conn module"
		default y
		---help---
		  The ngx_http_limit_conn_module module is used to limit the number of
		  connections per the defined key, in particular, the number of
		  connections from a single IP address.

		  Not all connections are counted. A connection is counted only if it
		  has a request processed by the server and the whole request header has
		  already been read.

		  Example configuration:

		    http {
		      limit_conn_zone $binary_remote_addr zone=addr:10m;

		      ...

		      server {
		        location /download/ {
		          limit_conn addr 1;
		        }
		      }
		    }

	config NGX_WITH_HTTP_LIMIT_REQ_MODULE
		bool "limit req module"
		default y
		---help---
		  The ngx_http_limit_req_module module is used to limit the request
		  processing rate per a defined key, in particular, the processing rate
		  of requests coming from a single IP address. The limitation is done
		  using the "leaky bucket" method. 

		  Example configuration:

		    http {
		      limit_req_zone $binary_remote_addr zone=one:10m rate=1r/s;

		      ...

		      server {
		        location /search/ {
		          limit_req zone=one burst=5;
		        }
		      }
		    }

	config NGX_WITH_HTTP_EMPTY_GIF_MODULE
		bool "empty gif module"
		default n
		---help---
		  Emits single-pixel transparent GIF

	config NGX_WITH_HTTP_BROWSER_MODULE
		bool "browser module"
		default y
		---help---


		  The ngx_http_browser_module module creates variables whose values
		  depend on the value of the "User-Agent" request header field:

		  $modern_browser
		    equals the value set by the modern_browser_value directive, if a
		    browser was identified as modern;
		  $ancient_browser
		    equals the value set by the ancient_browser_value directive, if a
		    browser was identified as ancient;
		  $msie
		    equals "1" if a browser was identified as MSIE of any version.

		  Example Configuration:

		  Choosing an index file:

		      modern_browser_value "modern.";

		      modern_browser msie      5.5;
		      modern_browser gecko     1.0.0;
		      modern_browser opera     9.0;
		      modern_browser safari    413;
		      modern_browser konqueror 3.0;

		      index index.${modern_browser}html index.html;

		  Redirection for old browsers:

		      modern_browser msie      5.0;
		      modern_browser gecko     0.9.1;
		      modern_browser opera     8.0;
		      modern_browser safari    413;
		      modern_browser konqueror 3.0;

		      modern_browser unlisted;

		      ancient_browser Links Lynx netscape4;

		      if ($ancient_browser) {
		          rewrite ^ /ancient.html;
		      }


	menuconfig NGX_WITH_HTTP_PROXY_MODULE
		bool "proxy module"
		default y

	if NGX_WITH_HTTP_PROXY_MODULE

		config NGX_WITH_HTTP_UPSTREAM_HASH_MODULE
			bool "upsteam hash module"
			default y
			---help---
			  Specifies a load balancing method for a server group where the
			  client-server mapping is based on the hashed key value. The key
			  can contain text, variables, and their combinations. Note that
			  adding or removing a server from the group may result in remapping
			  most of the keys to different servers.

			  If the consistent parameter is specified the ketama consistent
			  hashing method will be used instead. The method ensures that only
			  a few keys will be remapped to different servers when a server is
			  added to or removed from the group. This helps to achieve a higher
			  cache hit ratio for caching servers.

			  Syntax: hash key [consistent];

		config NGX_WITH_HTTP_UPSTREAM_IP_HASH_MODULE
			bool "upstream ip hash module"
			default y
			---help---
			  Specifies that a group should use a load balancing method where
			  requests are distributed between servers based on client IP
			  addresses. The first three octets of the client IPv4 address, or
			  the entire IPv6 address, are used as a hashing key. The method
			  ensures that requests from the same client will always be passed
			  to the same server except when this server is unavailable. In the
			  latter case client requests will be passed to another server. Most
			  probably, it will always be the same server as well.

			  Syntax:  ip_hash;

		config NGX_WITH_HTTP_UPSTREAM_LEAST_CONN_MODULE
			bool "upstream least conn module"
			default y
			---help---
			  Specifies that a group should use a load balancing method where a
			  request is passed to the server with the least number of active
			  connections, taking into account weights of servers. If there are
			  several such servers, they are tried in turn using a weighted
			  round-robin balancing method.

			  Syntax:  least_conn;

		config NGX_WITH_HTTP_UPSTREAM_KEEPALIVE_MODULE
			bool "upstream keepalive module"
			default y
			---help---
			  Activates the cache for connections to upstream servers.

			  The connections parameter sets the maximum number of idle
			  keepalive connections to upstream servers that are preserved in
			  the cache of each worker process. When this number is exceeded,
			  the least recently used connections are closed.

			  It should be particularly noted that the keepalive directive does
			  not limit the total number of connections to upstream servers
			  that an nginx worker process can open. The connections parameter
			  should be set to a number small enough to let upstream servers
			  process new incoming connections as well. 

			  Syntax:  keepalive connections;

		config NGX_WITH_HTTP_UPSTREAM_ZONE_MODULE
			bool "upstream zone module"
			default y
			---help---
			  Defines the name and size of the shared memory zone that keeps
			  the group’s configuration and run-time state that are shared
			  between worker processes. Several groups may share the same zone.
			  In this case, it is enough to specify the size only once. 

			  Syntax:  zone name [size];

	endif #NGX_WITH_HTTP_PROXY_MODULE

endif #HTTP

menuconfig NGX_WITH_STREAM
	bool "STREAM"
	default n

if NGX_WITH_STREAM
	comment "(SSL TCP/UDP proxy module) depends on 'Enable SSL'"
		depends on !ENABLE_SSL

	config NGX_WITH_STREAM_SSL_MODULE
		bool "SSL TCP/UDP proxy module"
		default y
		depends on ENABLE_SSL

	config NGX_WITH_STREAM_REALIP_MODULE
		bool "realip module"
		default n

	config NGX_WITH_STREAM_GEOIP_MODULE
		bool "geoip module"
		default n

	comment "(ssl preload module) depends on 'SSL TCP/UDP proxy module'"
		depends on !NGX_WITH_STREAM_SSL_MODULE¬

	config NGX_WITH_STREAM_SSL_PRELOAD_MODULE
		bool "ssl preload module"
		default n
		depends on NGX_WITH_STREAM_SSL_MODULE

	config NGX_WITH_STREAM_LIMIT_CONN_MODULE
		bool "limit conn module"
		default y

	config NGX_WITH_STREAM_ACCESS_MODULE
		bool "access module"
		default y

	config NGX_WITH_STREAM_GEO_MODULE
		bool "geo module"
		default y

	config NGX_WITH_STREAM_MAP_MODULE
		bool "map module"
		default y

	config NGX_WITH_STREAM_SPLIT_CLIENTS_MODULE
		bool "split clients module"
		default y

	config NGX_WITH_STREAM_RETURN_MODULE
		bool "return module"
		default y

	config NGX_WITH_STREAM_UPSTREAM_HASH_MODULE
		bool "upstream hash module"
		default y

	config NGX_WITH_STREAM_UPSTREAM_LEAST_CONN_MODULE
		bool "upstream least conn module"
		default y

	config NGX_WITH_STREAM_UPSTREAM_ZONE_MODULE
		bool "upstream zone module"
		default y

endif #NGX_WITH_STREAM

menu "External modules"
config NGX_MODULE_LUA_NGINX_MODULE
	bool "lua-nginx-module"
	select ENABLE_LUAJIT
	select NGX_MODULE_NGX_DEVEL_KIT
	select NGX_MODULE_SET_MISC_NGINX_MODULE
	default y
	---help---
	  Embed the Power of Lua into NGINX HTTP servers

	  https://github.com/openresty/lua-nginx-module

config NGX_MODULE_STREAM_LUA_NGINX_MODULE
	bool "stream-lua-nginx-module"
	select ENABLE_LUAJIT
	select NGX_WITH_STREAM
	select NGX_WITH_STREAM_SSL_MODULE if ENABLE_SSL
	default n
	---help---
	  Embed the power of Lua into Nginx stream/TCP Servers

	  This is a port of the ngx_http_lua_module to the NGINX "stream"
	  subsystem so as to support generic stream/TCP clients in the
	  downstream.

	  https://github.com/openresty/stream-lua-nginx-module

comment "(lua-upstream-nginx-module) depends on 'lua-nginx-module'"
	depends on !NGX_MODULE_LUA_NGINX_MODULE

config NGX_MODULE_LUA_UPSTREAM_NGINX_MODULE
	bool "lua-upstream-nginx-module"
	default n
	select ENABLE_LUAJIT
	depends on NGX_MODULE_LUA_NGINX_MODULE
	---help---
	  Nginx C module to expose Lua API to ngx_lua for Nginx upstreams

config NGX_MODULE_HEADERS_MORE_NGINX_MODULE
	bool "headers-more-nginx-module"
	default n
	---help---
	  Set, add, and clear arbitrary output headers in NGINX http servers

comment "(encrypted-session-nginx-module) depends on 'HTTP->SSL/TLS support'"
	depends on !NGX_WITH_HTTP_SSL_MODULE

config NGX_MODULE_ENCRYPTED_SESSION_NGINX_MODULE
	bool "encrypted-session-nginx-module"
	depends on NGX_WITH_HTTP_SSL_MODULE
	default n
	---help---
	  This module provides encryption and decryption support for nginx variables
	  based on AES-256 with Mac. Module is usually used with the ngx_set_misc
	  module and the standard rewrite module's directives.

	  This module can be used to implement simple user login and ACL.

	  Usually, you just decrypt data in nginx level, and pass the unencrypted
	  data to your FastCGI/HTTP backend, as in

config NGX_MODULE_ICONV_NGINX_MODULE
	bool "iconv-nginx-module"
	default n
	---help---
	  Character conversion nginx module using libiconv

config NGX_MODULE_NGINX_RTMP_MODULE
	bool "nginx-rtmp-module"
	default n
	---help---
	  NGINX-based Media Streaming Server

config NGX_MODULE_NGX_DEVEL_KIT
	bool "ngx_devel_kit"
	default y
	---help---
	  The NDK is an Nginx module that is designed to extend the core
	  functionality of the excellent Nginx webserver in a way that can
	  be used as a basis of other Nginx modules.

	  It has functions and macros to deal with generic tasks that don't
	  currently have generic code as part of the core distribution.
	  The NDK itself adds few features that are seen from a user's point
	  of view - it's just designed to help reduce the code that Nginx
	  module developers need to write.

	  The following 3rd-party modules make use of NDK
	    ngx_http_lua_module
	    ngx_http_set_misc_module
	    ngx_http_encrypted_session_module
	    ngx_http_form_input_module
	    ngx_http_iconv_module
	    ngx_http_array_var_module

	  https://github.com/simpl/ngx_devel_kit

comment "(set-misc-nginx-module) depends on 'ngx_devel_kit'"
	depends on !NGX_MODULE_NGX_DEVEL_KIT

config NGX_MODULE_SET_MISC_NGINX_MODULE
	bool "set-misc-nginx-module"
	default y
	depends on NGX_MODULE_NGX_DEVEL_KIT
	---help---
	  Various set_xxx directives added to nginx's rewrite module
	  (md5/sha1, sql/json quoting, and many more)

	  https://github.com/openresty/set-misc-nginx-module

config NGX_MODULE_NGX_COOLKIT
	bool "ngx_coolkit"
	default y
	---help---
	  ngx_coolkit is collection of small and useful nginx add-ons.

	  https://github.com/FRiCKLE/ngx_coolkit

config NGX_MODULE_ECHO_NGINX_MODULE
	bool "echo-nginx-module"
	default y
	---help---
	  Brings "echo", "sleep", "time", "exec" and more shell-style
	  goodies to Nginx config file

	  https://github.com/openresty/echo-nginx-module

endmenu

comment "(LUA modules) depends on 'lua-nginx-module' or 'stream-lua-nginx-module'"
	depends on !NGX_MODULE_LUA_NGINX_MODULE
	depends on !NGX_MODULE_STREAM_LUA_NGINX_MODULE

menu "LUA modules"
depends on NGX_MODULE_LUA_NGINX_MODULE||NGX_MODULE_STREAM_LUA_NGINX_MODULE
	config LUA_MODULE_CJSON
		bool "cjson"
		default y
		---help---
		  Lua CJSON is a fast JSON encoding/parsing module for Lua

		  https://github.com/openresty/lua-cjson

	config LUA_MODULE_CMSGPACK
		bool "cmsgpack"
		default y
		---help---
		  A self contained Lua MessagePack C implementation

		  https://github.com/antirez/lua-cmsgpack

	config LUA_MODULE_PGMOON
		bool "pgmoon"
		default n
		---help---
		  A pure Lua Postgres driver for use in OpenResty & more

		  https://github.com/leafo/pgmoon

	config LUA_MODULE_RESTY_CORE
		bool "resty.core"
		default y
		select LUA_MODULE_RESTY_LRUCACHE
		---help---
		  New FFI-based API for lua-nginx-module

		  This pure Lua library reimplements part of the ngx_lua module's
		  Nginx API for Lua with LuaJIT FFI and installs the new FFI-based
		  Lua API into the ngx.* and ndk.* namespaces used by the ngx_lua
		  module.

		  In addition, this Lua library implements any significant new Lua
		  APIs of the ngx_lua module as proper Lua modules, like ngx.semaphore
		  and ngx.balancer.

		  The FFI-based Lua API can work with LuaJIT's JIT compiler.
		  ngx_lua's default API is based on the standard Lua C API, which will
		  never be JIT compiled and the user Lua code is always interpreted
		  (slowly).

		  https://github.com/openresty/lua-resty-core

	config LUA_MODULE_RESTY_DNS
		bool "resty.dns"
		default y
		---help---
		  Lua DNS resolver for the ngx_lua based on the cosocket API

		  https://github.com/openresty/lua-resty-dns

	config LUA_MODULE_RESTY_KAFKA
		bool "resty.kafka"
		default n
		---help---
		  Lua kafka client driver for the Openresty based on the cosocket API

		  https://github.com/doujiang24/lua-resty-kafka

	config LUA_MODULE_RESTY_KYOTOTYCOON
		bool "resty.kyototycoon"
		default n
		---help---
		  Nonblocking Kyoto Tycoon client for Nginx

		  https://github.com/cloudflare/lua-resty-kyototycoon

	config LUA_MODULE_RESTY_LOCK
		bool "resty.lock"
		default y
		---help---
		   Simple nonblocking lock API for ngx_lua based on SHM dictionaries

		   https://github.com/openresty/lua-resty-lock

	config LUA_RESTY_LOGGER_SOCKET
		bool "resty.logger.socket"
		default n
		---help---
		  Nonblocking remote access logging for Nginx

	config LUA_MODULE_RESTY_LRUCACHE
		bool "resty.lrucache"
		default y
		---help---
		  Lua-land LRU Cache based on LuaJIT FFI

		  This cache also supports expiration time.

		  The LRU cache resides completely in the Lua VM and is subject to
		  Lua GC. So do not expect it to get shared across the OS process
		  boundary. The upside is that you can cache arbitrary complex Lua
		  values (like deep nested Lua tables) without the overhead of
		  serialization (as with ngx_lua's shared dictionary API).
		  The downside is that your cache is always limited to the current OS
		  process (like the current nginx worker process). It does not really
		  make much sense to use this library in the context of init_by_lua
		  because the cache will not get shared by any of the worker processes
		  (unless you just want to "warm up" the cache with predefined items
		  which will get inherited by the workers via fork).

		  There are two different implementations included in this library, in
		  the form of two classes: resty.lrucache and resty.lrucache.pureffi.
		  They share exactly the same API. The only difference is that the
		  latter is a pure FFI implementation that also implements an FFI-based
		  hash table for the cache lookup while the former uses native Lua
		  tables for it.

		  If the cache hit rate is relatively high, you should use the
		  resty.lrucache class which is faster than resty.lrucache.pureffi.

		  But if the cache hit rate is relatively low and there can be a lot of
		  variations of keys inserted into and removed from the cache, then you
		  should use the resty.lrucache.pureffi instead, because Lua tables are
		  not good at removing keys frequently by design and you would see the
		  resizetab function call in the LuaJIT runtime being very hot in on-CPU
		  flame graphs if you use the resty.lrucache class instead of
		  resty.lrucache.pureffi in this use case.

		  https://github.com/openresty/lua-resty-lrucache

	config LUA_MODULE_RESTY_MEMCACHED
		bool "resty.memcached"
		default n
		---help---
		  Lua memcached client driver for the ngx_lua based on the cosocket API

	config LUA_MODULE_RESTY_MYSQL
		bool "resty.mysql"
		default n
		---help---
		  Lua MySQL client driver for ngx_lua based on the cosocket API

	config LUA_MODULE_RESTY_REDIS
		bool "resty.redis"
		default n
		---help---
		  Lua redis client driver for the ngx_lua based on the cosocket API

	comment "(resty.string) depends on 'Enable SSL'"
		depends on !ENABLE_SSL

	config LUA_MODULE_RESTY_STRING
		bool "resty.string"
		default y
		depends on ENABLE_SSL
		---help---
		  String utilities and common hash functions for ngx_lua and LuaJIT

		  https://github.com/openresty/lua-resty-string

	config LUA_MODULE_RESTY_UPLOAD
		bool "resty.upload"
		default y
		---help---
		  Streaming reader and parser for http file uploading based on
		  ngx_lua cosocket

		  https://github.com/openresty/lua-resty-upload

	config LUA_MODULE_RESTY_UPSTREAM_HEALTHCHECK
		bool "resty.upstream.healthcheck"
		default y
		---help---
		  Health-checker for Nginx upstream servers

		  https://github.com/openresty/lua-resty-upstream-healthcheck

	config LUA_MODULE_RESTY_WEBSOCKET
		bool "resty.websocket"
		default y
		---help---
		  WebSocket support for the ngx_lua module

		  https://github.com/openresty/lua-resty-websocket
endmenu
```
